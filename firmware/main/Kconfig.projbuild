## firmware/main/Kconfig.projbuild
```kconfig
menu "Three-Body OTA Configuration"

    menu "WiFi"
        config ESP_WIFI_SSID
            string "WiFi SSID"
            default "YOUR_WIFI_NAME"
            help
                SSID (network name) to connect to.

        config ESP_WIFI_PASSWORD
            string "WiFi Password"
            default "YOUR_WIFI_PASSWORD"
            help
                WiFi password (WPA2).
    endmenu

    menu "Server"
        config FIRMWARE_SERVER_URL
            string "Firmware server base URL"
            default "http://192.168.1.100:8000"
            help
                Base URL of the FastAPI backend (no trailing slash).

        config MQTT_BROKER_URL
            string "MQTT broker URL"
            default "mqtt://192.168.1.100:1883"
            help
                MQTT broker URI (mqtt:// for plain TCP).
    endmenu

endmenu
```

## firmware/sdkconfig.defaults
```kconfig
# ── WiFi credentials (change these before building!) ──
CONFIG_ESP_WIFI_SSID="P3"
CONFIG_ESP_WIFI_PASSWORD="123456789"

# ── Server / Broker (change to your laptop's LAN IP) ──
CONFIG_FIRMWARE_SERVER_URL="http://10.22.88.26:8000"
CONFIG_MQTT_BROKER_URL="mqtt://10.22.88.26:1883"

# ── Bootloader / System ──
CONFIG_BOOTLOADER_LOG_LEVEL_WARN=y
CONFIG_ESP_SYSTEM_PANIC_PRINT_REBOOT=y

# ── Flash Size ──
CONFIG_ESPTOOLPY_FLASHSIZE_4MB=y
CONFIG_ESPTOOLPY_FLASHSIZE="4MB"

# ── Partition Table ──
CONFIG_PARTITION_TABLE_CUSTOM=y
CONFIG_PARTITION_TABLE_CUSTOM_FILENAME="partition.csv"
CONFIG_PARTITION_TABLE_FILENAME="partition.csv"
```
